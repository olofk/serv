## west.yml
```yaml
manifest:
  remotes:
    - name: zephyrproject-rtos
      url-base: https://github.com/zephyrproject-rtos
  projects:
    - name: zephyr
      remote: zephyrproject-rtos
      revision: v4.0.0
      import: true
```

## zephyr/Kconfig
```kconfig
# Copyright (c) 2020 Olof Kindgren <olof.kindgren@gmail.com>
# SPDX-License-Identifier: Apache-2.0

menu "SweRVolf"

rsource "drivers/Kconfig"

endmenu
```

## zephyr/boards/olofk/service/Kconfig.defconfig
```kconfig
# Copyright (c) 2020 Olof Kindgren <olof.kindgren@gmail.com>
#
# SPDX-License-Identifier: Apache-2.0

config BOARD
	default "service"
	depends on BOARD_SERVICE
```

## zephyr/boards/olofk/service/Kconfig.service
```kconfig
# Copyright (c) 2020 Olof Kindgren <olof.kindgren@gmail.com>
#
# SPDX-License-Identifier: Apache-2.0

config BOARD_SERVICE
	bool "servant SoC for iCE40"
	select SOC_RISCV32_SERVANT
```

## zephyr/boards/olofk/service/board.yml
```yaml
board:
  name: service
  full_name: Servant
  vendor: olofk
  socs:
    - name: servant
```

## zephyr/boards/olofk/service/service_defconfig
```kconfig
# Copyright (c) 2020 Olof Kindgren <olof.kindgren@gmail.com>
#
# SPDX-License-Identifier: Apache-2.0

CONFIG_BOARD_SERVICE=y
CONFIG_CONSOLE=y
CONFIG_SERIAL=y
CONFIG_UART_BITBANG=y

CONFIG_UART_CONSOLE=y

CONFIG_XIP=n
```

## zephyr/boards/riscv/service/Kconfig.board
```kconfig
# Copyright (c) 2020 Olof Kindgren <olof.kindgren@gmail.com>
#
# SPDX-License-Identifier: Apache-2.0

config BOARD_SERVICE
	bool "servant SoC for iCE40"
	depends on SOC_RISCV32_SERVANT
```

## zephyr/drivers/Kconfig
```kconfig
# Copyright (c) 2020 Olof Kindgren <olof.kindgren@gmail.com>
# SPDX-License-Identifier: Apache-2.0

menu "Device Drivers"

rsource "serial/Kconfig"

rsource "timer/Kconfig"

endmenu
```

## zephyr/drivers/serial/Kconfig
```kconfig
# Copyright (c) 2020 Olof Kindgren <olof.kindgren@gmail.com>
# SPDX-License-Identifier: Apache-2.0

if SERIAL

menuconfig UART_BITBANG
	bool "SERV bitbang serial driver"
	select SERIAL_HAS_DRIVER
	help
	  Enables the SERV bitbang serial driver.
	  Hardcoded to send at ~57600 baud rate with a 16MHz clock

endif
```

## zephyr/drivers/timer/Kconfig
```kconfig
# Copyright (c) 2020 Olof Kindgren <olof.kindgren@gmail.com>
# SPDX-License-Identifier: Apache-2.0

config SERV_TIMER
	bool "SERV Timer"
#	select TICKLESS_CAPABLE
	help
	  This module implements a kernel device driver for the SERV
	  timer driver. It provides the standard "system clock driver" interfaces.
```

## zephyr/soc/olofk/servant/Kconfig
```kconfig
# Copyright (c) 2021,2025 Henrik Brix Andersen <henrik@brixandersen.dk>
# SPDX-License-Identifier: Apache-2.0

config SOC_RISCV32_SERVANT
	select RISCV
	#select RISCV_PRIVILEGED
	#select RISCV_SOC_HAS_GP_RELATIVE_ADDRESSING
	select ATOMIC_OPERATIONS_C
	select RISCV_ISA_EXT_ZICSR
	imply XIP
```

## zephyr/soc/olofk/servant/Kconfig.defconfig
```kconfig
# Copyright (c) 2020 Olof Kindgren <olof.kindgren@gmail.com>
# SPDX-License-Identifier: Apache-2.0

if SOC_RISCV32_SERVANT

config SYS_CLOCK_HW_CYCLES_PER_SEC
	int
	default 16000000

config RISCV_SOC_INTERRUPT_INIT
	bool
	default y

config NUM_IRQS
	int
	default 8

config SERV_TIMER
	bool
	default y

config RISCV_SOC_EXCEPTION_FROM_IRQ
	bool
	default y

endif # SOC_RISCV32_SERVANT
```

## zephyr/soc/olofk/servant/Kconfig.soc
```kconfig
# Copyright (c) 2020 Olof Kindgren <olof.kindgren@gmail.com>
# SPDX-License-Identifier: Apache-2.0

config SOC_RISCV32_SERVANT
	bool "servant SoC"

config SOC
	default "servant" if SOC_RISCV32_SERVANT
```

## zephyr/soc/riscv/servant/Kconfig.defconfig
```kconfig
# Copyright (c) 2020 Olof Kindgren <olof.kindgren@gmail.com>
# SPDX-License-Identifier: Apache-2.0

if SOC_RISCV32_SERVANT

config SOC
	string
	default "servant"

config SYS_CLOCK_HW_CYCLES_PER_SEC
	int
	default 16000000

config RISCV_SOC_INTERRUPT_INIT
	bool
	default y

config NUM_IRQS
	int
	default 8

config SERV_TIMER
	bool
	default y

config ARCH_HAS_CUSTOM_CPU_IDLE
        bool
        default y

config ARCH_HAS_CUSTOM_CPU_ATOMIC_IDLE
        bool
        default y

config RISCV_SOC_EXCEPTION_FROM_IRQ
	bool
	default y

endif # SOC_RISCV32_SERVANT
```

## zephyr/soc/riscv/servant/Kconfig.soc
```kconfig
# Copyright (c) 2020 Olof Kindgren <olof.kindgren@gmail.com>
# SPDX-License-Identifier: Apache-2.0

config SOC_RISCV32_SERVANT
	bool "servant SoC"
	select RISCV
	select ATOMIC_OPERATIONS_C
```
